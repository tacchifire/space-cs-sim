## CMakeLists.txt
```
# SPDX-License-Identifier: Apache-2.0
cmake_minimum_required(VERSION 3.20)
find_package(Zephyr REQUIRED HINTS $ENV{ZEPHYR_BASE})
project(cuberange_csp_ping)

# Node identity is a build-time parameter, so one source tree produces every node role.
# Pass with:  west build ... -- -DCUBERANGE_NODE_ADDR=2
set(CUBERANGE_NODE_ADDR   1 CACHE STRING "CSP address of this node")
set(CUBERANGE_PEER_ADDR   2 CACHE STRING "CSP address this node pings")
set(CUBERANGE_CLIENT_ADDR 1 CACHE STRING "which address runs the ping client")

target_sources(app PRIVATE src/main.c)
target_link_libraries(app PRIVATE csp)
target_compile_definitions(app PRIVATE
  CUBERANGE_NODE_ADDR=${CUBERANGE_NODE_ADDR}
  CUBERANGE_PEER_ADDR=${CUBERANGE_PEER_ADDR}
  CUBERANGE_CLIENT_ADDR=${CUBERANGE_CLIENT_ADDR}
)
```

## prj.conf
```kconfig
CONFIG_LIBCSP=y
CONFIG_CSP_USE_RTABLE=n
CONFIG_CSP_HAVE_CAN=y

CONFIG_PICOLIBC=y
CONFIG_CAN=y
CONFIG_EVENTS=y
CONFIG_HEAP_MEM_POOL_SIZE=4096

# Keep the console quiet and on usart3. The space link will live on a different UART; see the
# design's UART assignment section. Logging is off so the console carries only our own printk.
CONFIG_LOG=n
CONFIG_BOOT_BANNER=y
```

## boards/nucleo_h753zi.overlay
```dts
/*
 * CubeRange: put the space link on usart2, leaving usart3 as Zephyr's console.
 *
 * The board's own devicetree sets zephyr,console = &usart3 and zephyr,shell-uart = &usart3.
 * Sharing that UART with the space link means a ground station connecting to the link socket
 * receives 9239 bytes of Zephyr boot banner before the first application byte. usart2 is present
 * on the SoC but `status = "disabled"` in stm32h7.dtsi, so it has to be enabled here.
 *
 * Pins are the Nucleo-144 defaults for USART2 on this package: PA2 (TX) / PA3 (RX).
 */
&usart2 {
	pinctrl-0 = <&usart2_tx_pa2 &usart2_rx_pa3>;
	pinctrl-names = "default";
	current-speed = <115200>;
	status = "okay";
};

/ {
	aliases {
		spacelink = &usart2;
	};
};
```

## src/main.c
```c
/*
 * CubeRange walking skeleton: CSP over CAN between two emulated satellite nodes.
 *
 * One image, two roles, selected at build time by CUBERANGE_NODE_ADDR. The node whose address
 * matches CUBERANGE_CLIENT_ADDR also pings its peer; every node answers pings, because libcsp's
 * csp_service_handler implements the CMP ping service for us.
 *
 * Deliberately uses DT_CHOSEN(zephyr_canbus) rather than DT_NODELABEL(can0). libcsp's own Zephyr
 * sample hardcodes can0, which does not exist on nucleo_h753zi - its controller is fdcan1. The
 * board's devicetree already declares `zephyr,canbus = &fdcan1`, so the chosen node is both
 * correct here and portable to any board that declares a CAN bus.
 *
 * SPDX-License-Identifier: Apache-2.0
 */
#include <zephyr/kernel.h>
#include <zephyr/device.h>
#include <zephyr/sys/printk.h>
#include <zephyr/drivers/uart.h>

#include <csp/csp.h>
#include <csp/drivers/can_zephyr.h>

#ifndef CUBERANGE_NODE_ADDR
#define CUBERANGE_NODE_ADDR 1
#endif
#ifndef CUBERANGE_PEER_ADDR
#define CUBERANGE_PEER_ADDR 2
#endif
#ifndef CUBERANGE_CLIENT_ADDR
#define CUBERANGE_CLIENT_ADDR 1
#endif

#define CAN_BITRATE   1000000
#define CSP_PORT_ECHO 10

#define ROUTER_STACK 1024
#define SERVER_STACK 1024
#define ROUTER_PRIO  0
#define SERVER_PRIO  1

static csp_iface_t *can_iface;

static void router_task(void *a, void *b, void *c)
{
	ARG_UNUSED(a); ARG_UNUSED(b); ARG_UNUSED(c);
	while (1) {
		csp_route_work();
	}
}

static void server_task(void *a, void *b, void *c)
{
	ARG_UNUSED(a); ARG_UNUSED(b); ARG_UNUSED(c);

	csp_socket_t sock = {0};
	csp_bind(&sock, CSP_ANY);
	csp_listen(&sock, 4);
	printk("CUBERANGE: node %d listening\n", CUBERANGE_NODE_ADDR);

	while (1) {
		csp_conn_t *conn = csp_accept(&sock, 1000);
		if (conn == NULL) {
			continue;
		}
		csp_packet_t *packet;
		while ((packet = csp_read(conn, 50)) != NULL) {
			switch (csp_conn_dport(conn)) {
			case CSP_PORT_ECHO:
				printk("CUBERANGE: node %d echo %u bytes from %d\n",
				       CUBERANGE_NODE_ADDR, packet->length, csp_conn_src(conn));
				csp_send(conn, packet);
				break;
			default:
				/* Ping, uptime, memfree and friends are handled here. */
				csp_service_handler(packet);
				break;
			}
		}
		csp_close(conn);
	}
}

K_THREAD_DEFINE(router_id, ROUTER_STACK, router_task, NULL, NULL, NULL,
		ROUTER_PRIO, 0, K_TICKS_FOREVER);
K_THREAD_DEFINE(server_id, SERVER_STACK, server_task, NULL, NULL, NULL,
		SERVER_PRIO, 0, K_TICKS_FOREVER);

int main(void)
{
	printk("CUBERANGE: node %d booting (peer %d)\n",
	       CUBERANGE_NODE_ADDR, CUBERANGE_PEER_ADDR);

	/* Pin CSP v1. libcsp defaults csp_conf.version to 2 (src/csp_init.c:18) and selects the
	 * header and CFP layouts from it at RUNTIME, so "we use CSP v1" is not true unless it is set
	 * here. Both versions interoperate with themselves, which is why a v2 satellite talking to a
	 * v2 satellite looks perfectly healthy right up until a v1 tool tries to join the bus - the
	 * frames are simply ignored, with no error anywhere. The ground tooling and the golden vectors
	 * in tests/golden/csp.json are v1; the 48-bit v2 header is not wire-compatible. */
	csp_conf.version = 1;
	csp_init();
	k_thread_start(router_id);

	const struct device *can_dev = DEVICE_DT_GET(DT_CHOSEN(zephyr_canbus));

	if (!device_is_ready(can_dev)) {
		printk("CUBERANGE: FATAL can device not ready\n");
		return -1;
	}

	/* filter_mask 0 accepts every address, so a node can see traffic that is not addressed to
	 * it. That is deliberate: this is a security range, and an exercise needs to be able to
	 * observe the bus the way an attacker or a compromised subsystem would. */
	int err = csp_can_open_and_add_interface(can_dev, "CAN", CUBERANGE_NODE_ADDR,
						 CAN_BITRATE, CUBERANGE_NODE_ADDR, 0x3FFF,
						 &can_iface);
	if (err != CSP_ERR_NONE) {
		printk("CUBERANGE: FATAL csp_can_open_and_add_interface -> %d\n", err);
		return -1;
	}
	can_iface->is_default = 1;
	printk("CUBERANGE: node %d CAN interface up on %s\n",
	       CUBERANGE_NODE_ADDR, can_dev->name);

	k_thread_start(server_id);

	/* The space link lives on its own UART (see boards/nucleo_h753zi.overlay). Writing a marker
	 * here proves the console and the link are genuinely separate streams - the marker must
	 * appear on the link and NOWHERE on the console. */
#if DT_NODE_HAS_STATUS(DT_ALIAS(spacelink), okay)
	const struct device *link = DEVICE_DT_GET(DT_ALIAS(spacelink));
	if (device_is_ready(link)) {
		const char *marker = "CUBERANGE-LINK\r\n";
		for (const char *p = marker; *p; p++) {
			uart_poll_out(link, *p);
		}
		printk("CUBERANGE: node %d space link up on %s\n",
		       CUBERANGE_NODE_ADDR, link->name);
	} else {
		printk("CUBERANGE: space link device not ready\n");
	}
#else
	printk("CUBERANGE: no spacelink alias in devicetree\n");
#endif

	if (CUBERANGE_NODE_ADDR != CUBERANGE_CLIENT_ADDR) {
		/* Server-only node: nothing else to do on this thread. */
		return 0;
	}

	/* Give the peer time to bring its own interface up before the first ping. */
	k_sleep(K_MSEC(500));

	for (unsigned int i = 0; i < 20; i++) {
		int ms = csp_ping(CUBERANGE_PEER_ADDR, 1000, 8, CSP_O_NONE);
		if (ms >= 0) {
			printk("CUBERANGE: ping %u -> node %d ok (%d ms)\n",
			       i, CUBERANGE_PEER_ADDR, ms);
		} else {
			printk("CUBERANGE: ping %u -> node %d TIMEOUT\n",
			       i, CUBERANGE_PEER_ADDR);
		}
		k_sleep(K_MSEC(200));
	}
	printk("CUBERANGE: client finished\n");
	return 0;
}
```
